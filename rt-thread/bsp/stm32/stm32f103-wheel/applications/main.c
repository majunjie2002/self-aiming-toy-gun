/*
 * Copyright (c) 2006-2018, RT-Thread Development Team
 *
 * SPDX-License-Identifier: Apache-2.0
 *
 * Change Logs:
 * Date           Author       Notes
 * 2022-08-12     Chen         first version
 */

#include <rtthread.h>
#include <rtdevice.h>
#include <board.h>

#define LED_PIN    		GET_PIN(C, 6)
#define MODE_PIN   		GET_PIN(C, 7)

#define RELAY_PIN0    	GET_PIN(A, 9)
#define RELAY_PIN1   	GET_PIN(A, 10)

rt_device_t dev2 = RT_NULL;
static rt_sem_t semaph2 = RT_NULL;
rt_device_t dev5 = RT_NULL;
static rt_sem_t semaph5 = RT_NULL;

#define BUFFER_SIZE     	(256)
#define MOTOR_SIZE      	(8)
#define CMD_SIZE      		(8)
rt_uint8_t set_motor_modbus1[MOTOR_SIZE]	={0x01,0x06,0x00,0x00,0x00,0x01,0x48,0x0A};
rt_uint8_t set_motor_acc1[MOTOR_SIZE]		={0x01,0x06,0x00,0x03,0x75,0x30,0x5F,0x4E};
rt_uint8_t set_motor_speed1[MOTOR_SIZE]		={0x01,0x06,0x00,0x02,0x00,0x10,0x29,0xC6};
rt_uint8_t set_motor_modbus2[MOTOR_SIZE]	={0x02,0x06,0x00,0x00,0x00,0x01,0x48,0x39};
rt_uint8_t set_motor_acc2[MOTOR_SIZE]		={0x02,0x06,0x00,0x03,0x75,0x30,0x5F,0x7D};
rt_uint8_t set_motor_speed2[MOTOR_SIZE]		={0x02,0x06,0x00,0x02,0x00,0x10,0x29,0xF5};

static unsigned char auchCRCHi[] = {
	0x00, 0xC1, 0x81, 0x40, 0x01, 0xC0, 0x80, 0x41, 0x01, 0xC0, 0x80, 0x41, 0x00, 0xC1, 0x81, 0x40, 0x01, 0xC0, 0x80,
	0x41, 0x00, 0xC1, 0x81, 0x40, 0x00, 0xC1, 0x81, 0x40, 0x01, 0xC0,
	0x80, 0x41, 0x01, 0xC0, 0x80, 0x41, 0x00, 0xC1, 0x81, 0x40, 0x00, 0xC1, 0x81, 0x40, 0x01, 0xC0, 0x80, 0x41, 0x00,
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	0x00, 0xC1, 0x81, 0x40, 0x01, 0xC0, 0x80, 0x41, 0x01, 0xC0, 0x80, 0x41, 0x00, 0xC1, 0x81, 0x40
} ;
static char auchCRCLo[] = {
	0x00, 0xC0, 0xC1, 0x01, 0xC3, 0x03, 0x02, 0xC2, 0xC6, 0x06, 0x07, 0xC7, 0x05, 0xC5, 0xC4, 0x04, 0xCC, 0x0C, 0x0D,
	0xCD, 0x0F, 0xCF, 0xCE, 0x0E, 0x0A, 0xCA, 0xCB, 0x0B, 0xC9, 0x09, 0x08, 0xC8, 0xD8, 0x18, 0x19, 0xD9, 0x1B,
	0xDB, 0xDA, 0x1A, 0x1E, 0xDE, 0xDF, 0x1F, 0xDD, 0x1D, 0x1C, 0xDC, 0x14, 0xD4, 0xD5, 0x15, 0xD7, 0x17, 0x16,
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	0x85, 0x45, 0x87, 0x47, 0x46, 0x86, 0x82, 0x42, 0x43, 0x83, 0x41, 0x81, 0x80, 0x40 
};

static rt_err_t uart5_hook_callback(rt_device_t dev, rt_size_t sz)
{
    rt_sem_release(semaph5);
    
    return RT_EOK;
}
void CRC161(rt_uint8_t *puchMsg,rt_uint8_t usDataLen)
{
	rt_uint8_t uchCRCHi = 0xFF ;
	rt_uint8_t uchCRCLo = 0xFF ;
	rt_uint8_t uIndex ;
	while (usDataLen--)
	{
		uIndex = uchCRCHi ^ *puchMsg++ ;
		uchCRCHi = uchCRCLo ^ auchCRCHi[uIndex] ; 
		uchCRCLo = auchCRCLo[uIndex] ;
	}
	set_motor_speed1[6]=uchCRCHi;
	set_motor_speed1[7]=uchCRCLo;
}
void CRC162(rt_uint8_t *puchMsg,rt_uint8_t usDataLen)
{
	rt_uint8_t uchCRCHi = 0xFF ;
	rt_uint8_t uchCRCLo = 0xFF ;
	rt_uint8_t uIndex ;
	while (usDataLen--)
	{
		uIndex = uchCRCHi ^ *puchMsg++ ;
		uchCRCHi = uchCRCLo ^ auchCRCHi[uIndex] ; 
		uchCRCLo = auchCRCLo[uIndex] ;
	}
	set_motor_speed2[6]=uchCRCHi;
	set_motor_speed2[7]=uchCRCLo;
}
void motor_speed1(rt_int16_t speed)
{
	if(speed<0)
	{
		set_motor_speed1[4]=(65536+speed)/256;
		set_motor_speed1[5]=(65536+speed)%256;
	}
	else
	{
		set_motor_speed1[4]=speed/256;
		set_motor_speed1[5]=speed%256;
	}
	CRC161(set_motor_speed1,MOTOR_SIZE-2);
	rt_device_write(dev2, 0, set_motor_speed1, MOTOR_SIZE);
}
void motor_speed2(rt_int16_t speed)
{
	if(speed<0)
	{
		set_motor_speed2[4]=(65536+speed)/256;
		set_motor_speed2[5]=(65536+speed)%256;
	}
	else
	{
		set_motor_speed2[4]=speed/256;
		set_motor_speed2[5]=speed%256;
	}
	CRC162(set_motor_speed2,MOTOR_SIZE-2);
	rt_device_write(dev2, 0, set_motor_speed2, MOTOR_SIZE);
}

static void uart5_rx_entry(void* parameter)
{
	rt_err_t result = RT_EOK;
	rt_uint8_t *pbuf = RT_NULL;
    rt_size_t szbuf=0;
	
	pbuf = rt_malloc(BUFFER_SIZE);
    RT_ASSERT(pbuf != RT_NULL);
	
	rt_thread_mdelay(1000);
	rt_device_write(dev2, 0, set_motor_modbus1, MOTOR_SIZE);
	rt_thread_mdelay(1000);
	rt_device_write(dev2, 0, set_motor_modbus2, MOTOR_SIZE);
	rt_thread_mdelay(1000);
	rt_device_write(dev2, 0, set_motor_acc1, MOTOR_SIZE);
	rt_thread_mdelay(1000);
	rt_device_write(dev2, 0, set_motor_acc2, MOTOR_SIZE);
	rt_thread_mdelay(1000);
	
    while (RT_TRUE)
	{
        result = rt_sem_take(semaph5, RT_WAITING_FOREVER);
		if(result == -RT_ETIMEOUT)
            continue; 
        
        switch (szbuf){
        case 0:
        case 1:
            szbuf += rt_device_read(dev5, 0, pbuf + szbuf, 1);
            if (pbuf[0] != 0xEE)
                szbuf = 0;
            break;
        default:
            szbuf += rt_device_read(dev5, 0, pbuf + szbuf, CMD_SIZE - szbuf);
            break;
        }
        if (szbuf != CMD_SIZE)
            continue;   
        szbuf = 0;

		if(pbuf[1]==0)
		{
			motor_speed1(pbuf[2]);
		}
		else
		{
			motor_speed1(-pbuf[2]);
		}
		rt_thread_mdelay(10);
		if(pbuf[3]==0)
		{
			motor_speed2(pbuf[4]);
		}
		else
		{
			motor_speed2(-pbuf[4]);
		}
		if(pbuf[5]==0)
		{
			rt_pin_write(RELAY_PIN0, PIN_LOW);
		}
		else
		{
			rt_pin_write(RELAY_PIN0, PIN_HIGH);
		}
		if(pbuf[6]==0)
		{
			rt_pin_write(RELAY_PIN1, PIN_LOW);
		}
		else
		{
			rt_pin_write(RELAY_PIN1, PIN_HIGH);
		}
    }
}

int main(void)
{
	rt_err_t result = RT_EOK;
	rt_thread_t pthread = RT_NULL;
	
    rt_pin_mode(LED_PIN, PIN_MODE_OUTPUT);
    rt_pin_mode(MODE_PIN, PIN_MODE_OUTPUT);
	rt_pin_mode(RELAY_PIN0, PIN_MODE_OUTPUT);
    rt_pin_mode(RELAY_PIN1, PIN_MODE_OUTPUT);
	rt_pin_write(RELAY_PIN0, PIN_LOW);
	rt_pin_write(RELAY_PIN1, PIN_LOW);
	
	dev2 = rt_device_find("uart2");
    RT_ASSERT(dev2 != RT_NULL);
    rt_device_open(dev2, RT_DEVICE_OFLAG_RDWR | RT_DEVICE_FLAG_INT_RX);
	struct serial_configure config2 = RT_SERIAL_CONFIG_DEFAULT;
    config2.baud_rate = BAUD_RATE_19200;
    rt_device_control(dev2, RT_DEVICE_CTRL_CONFIG, &config2);
	
	dev5 = rt_device_find("uart5");
    RT_ASSERT(dev5 != RT_NULL);
    rt_device_open(dev5, RT_DEVICE_OFLAG_RDWR | RT_DEVICE_FLAG_INT_RX);
	semaph5 = rt_sem_create("sh5" ,0, RT_IPC_FLAG_FIFO);
    RT_ASSERT(semaph5 != RT_NULL);
	rt_device_set_rx_indicate(dev5, uart5_hook_callback);
	pthread = rt_thread_create("rx5", uart5_rx_entry, RT_NULL, 2048, 6, 20);
    RT_ASSERT(pthread != RT_NULL);
    result = rt_thread_startup(pthread);
    RT_ASSERT(result == RT_EOK);
    
    while(RT_TRUE)
    {
        rt_thread_mdelay(500);
        
        if (rt_pin_read(LED_PIN))
		{
            rt_pin_write(LED_PIN, PIN_LOW);
			rt_pin_write(MODE_PIN, PIN_LOW);
		}
        else
		{
            rt_pin_write(LED_PIN, PIN_HIGH);
			rt_pin_write(MODE_PIN, PIN_HIGH);
		}
    }
    
    // never be here.
}
